## boards/others/foc_motor/Kconfig.foc_motor
```kconfig
# SPDX-License-Identifier: Apache-2.0

config BOARD_FOC_MOTOR
	select SOC_STM32G431XX
```

## boards/others/foc_motor/board.yml
```yaml
board:
  name: foc_motor
  full_name: foc_motor STM32G431RB controller
  vendor: others
  socs:
    - name: stm32g431xx
```

## boards/others/foc_motor/foc_motor_defconfig
```kconfig
# SPDX-License-Identifier: Apache-2.0

CONFIG_GPIO=y
CONFIG_ARM_MPU=y
CONFIG_HW_STACK_PROTECTION=y
```
