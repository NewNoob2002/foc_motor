/* SPDX-License-Identifier: Apache-2.0 */
#include "motor_ident.h"

#include <math.h>

/** Reset only per-target timers, retaining the filter and servo voltage. */
static void next_target(motor_ident_t* m, motor_ident_phase_t phase) {
    m->result.state = phase;
    m->target_n = 0U;
    m->reached_n = 0U;
    m->hold_n = 0U;
    m->reached = false;
}

/** Reset every value and begin alignment without a compiler-generated byte-loop memset. */
void motor_ident_start(motor_ident_t* m) {
    /* Volatile scalar stores keep the compiler from folding this back into memset.
     * Padding is not state and is never interpreted or published.
     */
    volatile motor_ident_t* reset = m;

    reset->result.state = IDENT_ALIGN_FIRST;
    reset->result.fail_reason = IDENT_FAIL_NONE;
    reset->result.enc_120 = 0U;
    reset->result.enc_240 = 0U;
    reset->result.enc_360 = 0U;
    reset->result.enc_return_120 = 0U;
    reset->result.enc_zero_back = 0U;
    reset->result.friction_half_e = 0;
    reset->result.delta_a = 0;
    reset->result.delta_b = 0;
    reset->result.direction = 0;
    reset->result.offset_e = 0U;
    for (uint32_t k = 0U; k < IDENT_R_POINTS; k++) {
        reset->result.points[k].v = 0.0f;
        reset->result.points[k].i = 0.0f;
    }
    reset->result.r = 0.0f;
    reset->result.v0 = 0.0f;
    reset->result.max_residual = 0.0f;
    reset->result.r_nonlinear = false;
    reset->result.l = 0.0f;
    reset->result.ipp = 0.0f;
    reset->theta_e_count = 0U;
    reset->align_step = 0U;
    reset->run_n = 0U;
    reset->overcurrent_n = 0U;
    reset->target_n = 0U;
    reset->reached_n = 0U;
    reset->hold_n = 0U;
    reset->point = 0U;
    reset->avg_n = 0U;
    reset->l_n = 0U;
    reset->increments = 0U;
    reset->reached = false;
    reset->filtered_i = 0.0f;
    reset->servo_v = 0.0f;
    reset->sum_v = 0.0f;
    reset->sum_i = 0.0f;
    reset->prev_i = 0.0f;
    reset->sum_delta = 0.0f;
}

/** Copy only values, using volatile scalar stores to prevent byte-loop memcpy synthesis. */
void motor_ident_result_copy(volatile motor_ident_result_t* dst, const motor_ident_result_t* src) {
    dst->state = src->state;
    dst->fail_reason = src->fail_reason;
    dst->enc_120 = src->enc_120;
    dst->enc_240 = src->enc_240;
    dst->enc_360 = src->enc_360;
    dst->enc_return_120 = src->enc_return_120;
    dst->enc_zero_back = src->enc_zero_back;
    dst->friction_half_e = src->friction_half_e;
    dst->delta_a = src->delta_a;
    dst->delta_b = src->delta_b;
    dst->direction = src->direction;
    dst->offset_e = src->offset_e;
    for (uint32_t k = 0U; k < IDENT_R_POINTS; k++) {
        dst->points[k].v = src->points[k].v;
        dst->points[k].i = src->points[k].i;
    }
    dst->r = src->r;
    dst->v0 = src->v0;
    dst->max_residual = src->max_residual;
    dst->r_nonlinear = src->r_nonlinear;
    dst->l = src->l;
    dst->ipp = src->ipp;
}

/** Latch an abort without discarding measurements already collected. */
void motor_ident_abort(motor_ident_t* m, motor_ident_fail_t reason) {
    if (m->result.state != IDENT_IDLE && m->result.state != IDENT_DONE && m->result.state != IDENT_FAILED) {
        m->result.state = IDENT_FAILED;
        m->result.fail_reason = reason;
        m->servo_v = 0.0f;
    }
}

/** Regulate current and require a continuous filtered-current dwell before declaring arrival. */
static void servo(motor_ident_t* m, float i, float ref) {
    /*
     * For an RL plant the continuous characteristic is L*s*s + R*s + Ki:
     * positive R,L,Ki give negative-real-part poles. Ki*T = 0.00025 V/A
     * keeps the sampled loop slow relative to the plant for the stated
     * bench range (R=0.02..5 ohm, L<5 mH), including the PWM preload delay.
     * This is a model argument, not a measured target WCET/stability result.
     */
    m->servo_v += IDENT_SERVO_KI * (ref - i) * IDENT_PERIOD_S;
    /* As with fmaxf(0, v), a NaN servo state clamps to zero. */
    if (!(m->servo_v > 0.0f)) {
        m->servo_v = 0.0f;
    } else if (m->servo_v > IDENT_V_MAX) {
        m->servo_v = IDENT_V_MAX;
    }
    if (!m->reached) {
        float band = ref > 0.0f ? IDENT_REACHED_FRAC * ref : IDENT_ZERO_BAND_A;

        m->target_n++;
        m->reached_n = fabsf(m->filtered_i - ref) < band ? m->reached_n + 1U : 0U;
        if (m->reached_n >= IDENT_REACHED_N) {
            m->reached = true;
        } else if (m->target_n >= IDENT_SERVO_TIMEOUT_N) {
            motor_ident_abort(m, IDENT_FAIL_SERVO_TIMEOUT);
        }
    }
}

/** Return the signed shortest mechanical displacement modulo one encoder turn. */
static int32_t align_delta(uint32_t from, uint32_t to) {
    int32_t delta = (int32_t)(to % IDENT_COUNTS) - (int32_t)(from % IDENT_COUNTS);

    if (delta > (int32_t)IDENT_COUNTS / 2) {
        delta -= (int32_t)IDENT_COUNTS;
    } else if (delta < -(int32_t)IDENT_COUNTS / 2) {
        delta += (int32_t)IDENT_COUNTS;
    }
    return delta;
}

/** Validate the first two forced positive electrical moves and retain the forward zero park A. */
static void align_result(motor_ident_t* m, uint32_t enc) {
    motor_ident_result_t* r = &m->result;

    r->enc_360 = enc;
    r->delta_a = align_delta(r->enc_120, r->enc_240);
    r->delta_b = align_delta(r->enc_240, r->enc_360);
    float move_a = (float)IDENT_POLE_PAIRS * fabsf((float)r->delta_a);
    float move_b = (float)IDENT_POLE_PAIRS * fabsf((float)r->delta_b);

    /* Both ideal moves round to 1365 counts; the first command gap is 1366.
     * The one-count rounding difference is included in the electrical tolerance.
     */
    if (r->delta_a == 0 || r->delta_b == 0 || (r->delta_a > 0) != (r->delta_b > 0)
        || fabsf(move_a - (float)IDENT_ALIGN_120) > (float)IDENT_ALIGN_TOL_E
        || fabsf(move_b - (float)IDENT_ALIGN_120) > (float)IDENT_ALIGN_TOL_E) {
        motor_ident_abort(m, IDENT_FAIL_ALIGNMENT);
        return;
    }
    r->direction = r->delta_a > 0 ? 1 : -1;
    next_target(m, IDENT_ALIGN_DECAY);
    m->servo_v = 0.0f;
}

/** Validate the extra positive/negative moves and circularly average the two zero parks. */
static void align_two_sided(motor_ident_t* m, uint32_t enc) {
    motor_ident_result_t* r = &m->result;
    int32_t forward = align_delta(r->enc_360, r->enc_return_120);
    int32_t backward = align_delta(r->enc_return_120, enc);

    r->enc_zero_back = enc;
    if (forward * r->direction <= 0 || backward * r->direction >= 0
        || fabsf(fabsf((float)(forward * (int32_t)IDENT_POLE_PAIRS)) - (float)IDENT_ALIGN_120)
               > (float)IDENT_ALIGN_TOL_E
        || fabsf(fabsf((float)(backward * (int32_t)IDENT_POLE_PAIRS)) - (float)IDENT_ALIGN_120)
               > (float)IDENT_ALIGN_TOL_E) {
        motor_ident_abort(m, IDENT_FAIL_ALIGNMENT);
        return;
    }
    uint32_t a = ((r->enc_360 % IDENT_COUNTS) * IDENT_POLE_PAIRS) % IDENT_COUNTS;
    uint32_t b = ((enc % IDENT_COUNTS) * IDENT_POLE_PAIRS) % IDENT_COUNTS;

    r->friction_half_e = align_delta(a, b) / 2;
    uint32_t mean = (a + (uint32_t)r->friction_half_e) & (IDENT_COUNTS - 1U);

    r->offset_e = r->direction > 0 ? mean : (IDENT_COUNTS - mean) % IDENT_COUNTS;
    next_target(m, IDENT_RESISTANCE);
}

/** Fit the four upper current targets once; retain every measured point for inspection. */
static void fit_resistance(motor_ident_t* m) {
    motor_ident_result_t* r = &m->result;
    float mean_i = 0.0f;
    float mean_v = 0.0f;

    /* Select by nominal target: noise can put the measured 0.75 A just below 0.75. */
    for (uint32_t k = IDENT_R_FIT_FIRST; k < IDENT_R_POINTS; k++) {
        mean_i += r->points[k].i;
        mean_v += r->points[k].v;
    }
    mean_i /= (float)(IDENT_R_POINTS - IDENT_R_FIT_FIRST);
    mean_v /= (float)(IDENT_R_POINTS - IDENT_R_FIT_FIRST);
    float variance = 0.0f;
    float covariance = 0.0f;

    for (uint32_t k = IDENT_R_FIT_FIRST; k < IDENT_R_POINTS; k++) {
        float di = r->points[k].i - mean_i;

        variance += di * di;
        covariance += di * (r->points[k].v - mean_v);
    }
    if (!(variance > 0.0f && covariance > 0.0f)) {
        motor_ident_abort(m, IDENT_FAIL_RESISTANCE);
        return;
    }
    r->r = covariance / variance;
    r->v0 = mean_v - r->r * mean_i;
    for (uint32_t k = IDENT_R_FIT_FIRST; k < IDENT_R_POINTS; k++) {
        float residual = fabsf(r->points[k].v - (r->r * r->points[k].i + r->v0));

        if (residual > r->max_residual) {
            r->max_residual = residual;
        }
    }
    float last_di = r->points[IDENT_R_POINTS - 1U].i - r->points[IDENT_R_POINTS - 2U].i;

    if (!(last_di > 0.0f) || !isfinite(r->r) || !isfinite(r->v0)) {
        motor_ident_abort(m, IDENT_FAIL_RESISTANCE);
        return;
    }
    float last_slope = (r->points[IDENT_R_POINTS - 1U].v - r->points[IDENT_R_POINTS - 2U].v) / last_di;

    r->r_nonlinear = r->max_residual > IDENT_R_RESIDUAL_FRAC * r->r * IDENT_R_TOP_A
                     || fabsf(last_slope - r->r) > IDENT_R_SLOPE_FRAC * r->r;
    next_target(m, IDENT_L_BIAS);
}

/** Record one settled operating point, then advance to the next target or the L injection. */
static void resistance_step(motor_ident_t* m, float i) {
    static const float targets[IDENT_R_POINTS] = IDENT_R_TARGETS_A;

    servo(m, i, targets[m->point]);
    if (m->result.state == IDENT_FAILED || !m->reached) {
        return;
    }
    if (m->hold_n < IDENT_R_SETTLE_N) {
        m->hold_n++;
        return;
    }
    m->sum_i += i;
    m->sum_v += m->servo_v;
    m->avg_n++;
    if (m->avg_n == IDENT_R_AVG_N) {
        m->result.points[m->point].i = m->sum_i * (1.0f / (float)IDENT_R_AVG_N);
        m->result.points[m->point].v = m->sum_v * (1.0f / (float)IDENT_R_AVG_N);
        m->point++;
        m->avg_n = 0U;
        m->sum_i = 0.0f;
        m->sum_v = 0.0f;
        if (m->point == IDENT_R_POINTS) {
            fit_resistance(m);
        } else {
            next_target(m, IDENT_RESISTANCE);
        }
    }
}

/** Return the sign of a square-wave command indexed by its output period. */
static float injection_sign(uint32_t n) {
    return ((n / IDENT_L_HALF) & 1U) == 0U ? 1.0f : -1.0f;
}

/** Accumulate current increments against the voltage that actually caused them. */
static float inductance_step(motor_ident_t* m, float i) {
    const uint32_t total = IDENT_L_CYCLES * 2U * IDENT_L_HALF;
    float bias = m->result.points[IDENT_R_BIAS_POINT].v;

    /* At call n, i[n]-i[n-1] is caused by output n-2 (CCR preload).
     * Flush two calls after the last output so the final increment is counted.
     */
    if (m->l_n >= 2U && m->l_n - 2U >= IDENT_L_DISCARD * 2U * IDENT_L_HALF) {
        m->sum_delta += injection_sign(m->l_n - 2U) * (i - m->prev_i);
        m->increments++;
    }
    m->prev_i = i;
    if (m->l_n == total + 1U) {
        float mean = m->sum_delta / (float)m->increments;

        if (!(mean > 0.0f) || !isfinite(mean)) {
            motor_ident_abort(m, IDENT_FAIL_INDUCTANCE);
            return 0.0f;
        }
        m->result.l = IDENT_L_VH * IDENT_PERIOD_S / mean;
        m->result.ipp = IDENT_L_VH * (float)IDENT_L_HALF * IDENT_PERIOD_S / m->result.l;
        if (!isfinite(m->result.l) || m->result.ipp > IDENT_L_IPP_MAX_A) {
            motor_ident_abort(m, IDENT_FAIL_RIPPLE);
        } else {
            m->result.state = IDENT_DONE;
        }
        return 0.0f;
    }
    float voltage = m->l_n < total ? bias + IDENT_L_VH * injection_sign(m->l_n) : bias;

    m->l_n++;
    return voltage;
}

/** Apply safety checks, advance one bounded phase, and emit the next PWM command. */
void motor_ident_step(motor_ident_t* m, const motor_ident_in_t* in, motor_ident_out_t* out) {
    float voltage = 0.0f;

    if (!isfinite(in->i_d)) {
        motor_ident_abort(m, IDENT_FAIL_NUMERIC);
    } else {
        /* Single-sample protection stays with power_guard's global 2 A per-phase ISR trip
         * (about 5 sigma above 1.5 A). This limit only stops a slow runaway of our own
         * servo, so isolated ADC noise spikes must not abort identification.
         */
        if (fabsf(in->i_d) > IDENT_I_ABORT_A) {
            if (m->overcurrent_n < IDENT_I_ABORT_N) {
                m->overcurrent_n++;
            }
            if (m->overcurrent_n >= IDENT_I_ABORT_N) {
                motor_ident_abort(m, IDENT_FAIL_OVERCURRENT);
            }
        } else {
            m->overcurrent_n = 0U;
        }
    }
    if (!in->power_on) {
        motor_ident_abort(m, IDENT_FAIL_NOT_POWERED);
    }
    if (m->result.state > IDENT_IDLE && m->result.state < IDENT_DONE) {
        m->run_n++;
        m->filtered_i += IDENT_FILTER_K * (in->i_d - m->filtered_i);
        if (m->run_n > IDENT_RUN_TIMEOUT_N) {
            motor_ident_abort(m, IDENT_FAIL_RUN_TIMEOUT);
        }
    }
    switch (m->result.state) {
        case IDENT_ALIGN_FIRST:
        case IDENT_ALIGN_SECOND:
        case IDENT_ALIGN_THIRD:
        case IDENT_ALIGN_ZERO:
        case IDENT_ALIGN_RETURN_120:
        case IDENT_ALIGN_BACK_ZERO:
            servo(m, in->i_d, IDENT_ALIGN_A);
            if (m->result.state == IDENT_FAILED) {
                break;
            }
            if (m->reached && ++m->hold_n >= IDENT_ALIGN_HOLD_N) {
                if (m->result.state == IDENT_ALIGN_ZERO) {
                    align_result(m, in->enc_count);
                } else if (m->result.state == IDENT_ALIGN_BACK_ZERO) {
                    align_two_sided(m, in->enc_count);
                } else {
                    if (m->result.state == IDENT_ALIGN_SECOND) {
                        m->result.enc_120 = in->enc_count;
                    } else if (m->result.state == IDENT_ALIGN_THIRD) {
                        m->result.enc_240 = in->enc_count;
                    } else if (m->result.state == IDENT_ALIGN_RETURN_120) {
                        m->result.enc_return_120 = in->enc_count;
                    }
                    /* The first zero-degree park is deliberately not used for direction.
                     * With sinusoidal torque and sufficient settling, it leaves the rotor
                     * near stable 0 or friction-held unstable 180 degrees. The 120 pull
                     * then moves +120 or -60 to the same stable position. Its unstable
                     * 300-degree position cannot persist through the preceding zero park
                     * (|sin(300)| = 0.866). This is not a universal +/-60-degree move;
                     * finite settling/friction must still be checked on the bench.
                     */
                    next_target(m, IDENT_ALIGN_DECAY);
                    m->servo_v = 0.0f;
                }
            }
            voltage = m->servo_v;
            break;
        case IDENT_ALIGN_DECAY:
            /* Remove excitation and verify decay before every angle switch. */
            servo(m, in->i_d, 0.0f);
            m->servo_v = 0.0f;
            if (m->reached && m->result.state != IDENT_FAILED) {
                m->align_step++;
                switch (m->align_step) {
                    case 1U:
                        m->theta_e_count = IDENT_ALIGN_120;
                        next_target(m, IDENT_ALIGN_SECOND);
                        break;
                    case 2U:
                        m->theta_e_count = IDENT_ALIGN_240;
                        next_target(m, IDENT_ALIGN_THIRD);
                        break;
                    case 3U:
                        m->theta_e_count = 0U;
                        next_target(m, IDENT_ALIGN_ZERO);
                        break;
                    case 4U:
                        m->theta_e_count = IDENT_ALIGN_120;
                        next_target(m, IDENT_ALIGN_RETURN_120);
                        break;
                    default:
                        m->theta_e_count = 0U;
                        next_target(m, IDENT_ALIGN_BACK_ZERO);
                        break;
                }
            }
            break;
        case IDENT_RESISTANCE:
            resistance_step(m, in->i_d);
            voltage = m->servo_v;
            break;
        case IDENT_L_BIAS:
            /* The final R point is 1.5 A. Restore 1 A before adding positive
             * injection, otherwise the first pulse can cross the abort limit.
             * Freeze at the recorded R voltage only after the bias has settled.
             */
            servo(m, in->i_d, IDENT_ALIGN_A);
            if (m->reached && ++m->hold_n >= IDENT_R_SETTLE_N) {
                next_target(m, IDENT_INDUCTANCE);
            }
            voltage = m->servo_v;
            break;
        case IDENT_INDUCTANCE:
            voltage = inductance_step(m, in->i_d);
            break;
        default:
            break;
    }
    out->done = m->result.state == IDENT_DONE;
    out->failed = m->result.state == IDENT_FAILED;
    out->v_d = out->done || out->failed ? 0.0f : voltage;
    out->theta_e_count = m->theta_e_count;
}
